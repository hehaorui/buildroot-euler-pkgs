## Config.in
```kconfig
source "$BR2_EXTERNAL_EULER_PKGS_PATH/package/etmem/Config.in"
source "$BR2_EXTERNAL_EULER_PKGS_PATH/package/libboundscheck/Config.in"
source "$BR2_EXTERNAL_EULER_PKGS_PATH/package/uthash/Config.in"
```

## package/etmem/Config.in
```kconfig
config BR2_PACKAGE_ETMEM
  bool "etmem"
  default n
  select BR2_PACKAGE_LIBBOUNDSCHECK
  select BR2_PACKAGE_UTHASH
  select BR2_PACKAGE_LIBGLIB2
  select BR2_PACKAGE_NUMACTL
  select BR2_PACKAGE_JSON_C
  select BR2_PACKAGE_LIBCAP
```

## package/libboundscheck/Config.in
```kconfig
config BR2_PACKAGE_LIBBOUNDSCHECK
  bool "libboundscheck"
  default n
  help
    libboundscheck is a library that provides bounds checking for C programs.
```

## package/uthash/Config.in
```kconfig
config BR2_PACKAGE_UTHASH
  bool "uthash" 
  default n
  help
    uthash is a hash table library in C.

    https://troydhanson.github.io/uthash/

    uthash is a hash table library in C. It is a single header file that
    provides a hash table implementation. It is a very simple library
    that is easy to use and provides a lot of functionality.

    This package is used by the Euler project.

    This package is not selected by default.
```
